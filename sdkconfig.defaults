## sdkconfig.defaults
```kconfig
CONFIG_ESP_MAIN_TASK_STACK_SIZE=20480
CONFIG_ESP_TASK_WDT=n
CONFIG_ESP32_DEFAULT_CPU_FREQ_240=y
CONFIG_ESP32_DEFAULT_CPU_FREQ_MHZ=240
```

## src/Kconfig.projbuild
```kconfig
menu "IOTA Wallet Settings"

    config WALLET_SEED
        string "SEED"
        default "random"
        help
            The seed of this wallet

    config NODE_ENDPOINT 
        string "Node endpoint"
        default ""
        help
            Set the connected node endpoint

    config NODE_PORT
        int "Port Number"
        default 0
        help
            Set the port number of endpoint

    config WIFI_SSID
        string "WiFi SSID"
        default "myssid"
        help
            SSID (network name) for the example to connect to.

    config WIFI_PASSWORD
        string "WiFi Password"
        default "mypassword"
        help
            WiFi password (WPA or WPA2) for the example to use.

    config WIFI_RETRY
        int "Maximum retry"
        default 5
        help
            Set the Maximum retry to avoid station reconnecting to the AP unlimited when the AP is really inexistent.
endmenu
```
